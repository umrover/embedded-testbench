# file: ehw-devboard.ioc
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Mcu.Family=STM32F1
Mcu.Name=STM32F100V(8-B)Tx
Mcu.Package=LQFP100
NVIC.PriorityGroup=NVIC_PRIORITYGROUP_4
ProjectManager.HeapSize=0x200
ProjectManager.StackSize=0x400
ProjectManager.TargetToolchain=STM32CubeIDE
RCC.APB1Freq_Value=8000000
RCC.APB2Freq_Value=8000000
VP_SYS_VS_ND.Mode=No_Debug
board=custom

// file: Core/Src/main.c
/* USER CODE BEGIN Header */
/**
  ******************************************************************************
  * @file           : main.c
  * @brief          : Main program body
  ******************************************************************************
  * @attention
  *
  * Copyright (c) 2022 STMicroelectronics.
  * All rights reserved.
  *
  * This software is licensed under terms that can be found in the LICENSE file
  * in the root directory of this software component.
  * If no LICENSE file comes with this software, it is provided AS-IS.
  *
  ******************************************************************************
  */
/* USER CODE END Header */
#include "main.h"

void SystemClock_Config(void);

int main(void)
{

  /* MCU Configuration--------------------------------------------------------*/

  /* Reset of all peripherals, Initializes the Flash interface and the Systick. */
  HAL_Init();

  /* Configure the system clock */
  SystemClock_Config();

  /* USER CODE BEGIN SysInit */
  static const uint8_t pins[] = {PA0, PA1, PA2, PA3, PA4, PA5, PA6, PA7, PA8, PA9, PA10, PA11, PA13, PA14,
  	  	  	  	  	  	  	  	  PC4, PC5, PC6, PC7, PC8, PC9,
  	  	  	  	  	  	  	  	  PB0, PB1, PB2, PB6, PB7, PB10, PB11, PB12, PB13, PB14, PB15,
								  PD8, PD9,PD10, PD11, PD12, PD13, PD14, PD15,
  	  	  	  	  	  	  	  	  PE7, PE9, PE11 };
  static const uint16_t port_a_pins[] = {GPIO_PIN_0, GPIO_PIN_1, GPIO_PIN_2, GPIO_PIN_3, GPIO_PIN_4, GPIO_PIN_5, GPIO_PIN_6, GPIO_PIN_7, GPIO_PIN_8, GPIO_PIN_9, GPIO_PIN_10, GPIO_PIN_11, GPIO_PIN_13, GPIO_PIN_14};
  static const uint16_t port_b_pins[] = {GPIO_PIN_0, GPIO_PIN_1, GPIO_PIN_2, GPIO_PIN_6, GPIO_PIN_7, GPIO_PIN_10, GPIO_PIN_11, GPIO_PIN_12, GPIO_PIN_13, GPIO_PIN_14, GPIO_PIN_15};
  static const uint16_t port_c_pins[] = {GPIO_PIN_4, GPIO_PIN_5, GPIO_PIN_6, GPIO_PIN_7, GPIO_PIN_8, GPIO_PIN_9};
  static const uint16_t port_d_pins[] = {GPIO_PIN_8, GPIO_PIN_9, GPIO_PIN_10, GPIO_PIN_11, GPIO_PIN_12, GPIO_PIN_13, GPIO_PIN_14, GPIO_PIN_15};
  static const uint16_t port_e_pins[] = {GPIO_PIN_7, GPIO_PIN_9, GPIO_PIN_11};
  /* USER CODE END SysInit */

  /* Initialize all configured peripherals */
  /* USER CODE BEGIN 2 */
   for (int i = 0; i < sizeof(pins)/sizeof(pins[0]); ++i) {
  	  digitalWrite(pins[i], GPIO_PIN_SET);
  	  digitalWrite(pins[i], GPIO_PIN_RESET);
    }

  for (int i = 0; i < sizeof(port_a_pins)/sizeof(port_a_pins[0]); ++i) {
	  HAL_GPIO_WritePin(GPIOA, port_a_pins[i], GPIO_PIN_SET);
	  HAL_GPIO_WritePin(GPIOE, port_a_pins[i], GPIO_PIN_RESET);
  }
  for (int i = 0; i < sizeof(port_b_pins)/sizeof(port_b_pins[0]); ++i) {
	  HAL_GPIO_WritePin(GPIOB, port_b_pins[i], GPIO_PIN_SET);
	  HAL_GPIO_WritePin(GPIOE, port_b_pins[i], GPIO_PIN_RESET);
    }
  for (int i = 0; i < sizeof(port_c_pins)/sizeof(port_c_pins[0]); ++i) {
	  HAL_GPIO_WritePin(GPIOC, port_c_pins[i], GPIO_PIN_SET);
	  HAL_GPIO_WritePin(GPIOE, port_c_pins[i], GPIO_PIN_RESET);
    }
  for (int i = 0; i < sizeof(port_d_pins)/sizeof(port_d_pins[0]); ++i) {
	  HAL_GPIO_WritePin(GPIOD, port_d_pins[i], GPIO_PIN_SET);
	  HAL_GPIO_WritePin(GPIOE, port_d_pins[i], GPIO_PIN_RESET);
    }
  for (int i = 0; i < sizeof(port_e_pins)/sizeof(port_e_pins[0]); ++i) {
	  HAL_GPIO_WritePin(GPIOE, port_e_pins[i], GPIO_PIN_SET);
	  HAL_GPIO_WritePin(GPIOE, port_e_pins[i], GPIO_PIN_RESET);
    }
  /* USER CODE END 2 */

  /* Infinite loop */
  while (1)
  {

  }
}

void SystemClock_Config(void)
{
  RCC_OscInitTypeDef RCC_OscInitStruct = {0};
  RCC_ClkInitTypeDef RCC_ClkInitStruct = {0};

  /** Initializes the RCC Oscillators according to the specified parameters
  * in the RCC_OscInitTypeDef structure.
  */
  RCC_OscInitStruct.OscillatorType = RCC_OSCILLATORTYPE_HSI;
  RCC_OscInitStruct.HSIState = RCC_HSI_ON;
  RCC_OscInitStruct.HSICalibrationValue = RCC_HSICALIBRATION_DEFAULT;
  RCC_OscInitStruct.PLL.PLLState = RCC_PLL_NONE;
  if (HAL_RCC_OscConfig(&RCC_OscInitStruct) != HAL_OK)
  {
    Error_Handler();
  }

  /** Initializes the CPU, AHB and APB buses clocks
  */
  RCC_ClkInitStruct.ClockType = RCC_CLOCKTYPE_HCLK|RCC_CLOCKTYPE_SYSCLK
                              |RCC_CLOCKTYPE_PCLK1|RCC_CLOCKTYPE_PCLK2;
  RCC_ClkInitStruct.SYSCLKSource = RCC_SYSCLKSOURCE_HSI;
  RCC_ClkInitStruct.AHBCLKDivider = RCC_SYSCLK_DIV1;
  RCC_ClkInitStruct.APB1CLKDivider = RCC_HCLK_DIV1;
  RCC_ClkInitStruct.APB2CLKDivider = RCC_HCLK_DIV1;

  if (HAL_RCC_ClockConfig(&RCC_ClkInitStruct, FLASH_LATENCY_0) != HAL_OK)
  {
    Error_Handler();
  }
}

void Error_Handler(void)
{
  __disable_irq();
  while (1)
  {
  }
}
